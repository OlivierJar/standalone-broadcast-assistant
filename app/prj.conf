## CMakeLists.txt
```
#-------------------------------------------------------------------------------
# Zephyr Example Application
#
# Copyright (c) 2021 Nordic Semiconductor ASA
# SPDX-License-Identifier: Apache-2.0

cmake_minimum_required(VERSION 3.20.0)
find_package(Zephyr REQUIRED HINTS $ENV{ZEPHYR_BASE})

project(standalone-broadcast-assistant)

FILE(GLOB app_sources src/*.c)
target_sources(app PRIVATE ${app_sources})
```

## prj.conf
```kconfig
# Stack Size
CONFIG_MAIN_STACK_SIZE=8192
CONFIG_SYSTEM_WORKQUEUE_STACK_SIZE=8192

# Display
CONFIG_DISPLAY=y
CONFIG_DISPLAY_LOG_LEVEL_ERR=y

# LVGL
CONFIG_LVGL=y
CONFIG_LV_Z_SHELL=y

CONFIG_LV_Z_MEM_POOL_SIZE=16384

CONFIG_LV_MEM_CUSTOM=y
CONFIG_LV_USE_LABEL=y
CONFIG_LV_USE_BTN=y
CONFIG_LV_USE_ARC=y
CONFIG_LV_USE_IMG=y
CONFIG_LV_USE_MONKEY=y
CONFIG_LV_FONT_MONTSERRAT_14=y

# BT
CONFIG_BT=y
CONFIG_BT_CENTRAL=y
CONFIG_BT_SMP=y
CONFIG_BT_AUDIO=y

CONFIG_BT_PRIVACY=y
CONFIG_BT_SIGNING=y
CONFIG_BT_REMOTE_INFO=y
CONFIG_BT_REMOTE_VERSION=y
CONFIG_BT_MAX_CONN=3
CONFIG_BT_MAX_PAIRED=3
CONFIG_BT_FIXED_PASSKEY=y

CONFIG_BT_EXT_ADV=y
CONFIG_BT_BONDABLE=y
CONFIG_BT_TINYCRYPT_ECC=y
CONFIG_BT_BUF_ACL_RX_SIZE=255
CONFIG_BT_BUF_ACL_TX_SIZE=251
CONFIG_BT_CTLR_SCAN_DATA_LEN_MAX=191

# Volume Control
CONFIG_BT_VCP_VOL_CTLR=y
CONFIG_BT_VCP_VOL_CTLR_MAX_VOCS_INST=1
CONFIG_BT_VCP_VOL_CTLR_MAX_AICS_INST=3
CONFIG_BT_VOCS_CLIENT_MAX_INSTANCE_COUNT=1
CONFIG_BT_AICS_CLIENT_MAX_INSTANCE_COUNT=3

# USB
CONFIG_RING_BUFFER=y
CONFIG_USB_DEVICE_STACK=y
CONFIG_USB_DEVICE_BOS=y
CONFIG_USB_DEVICE_PRODUCT="VCP Graphical Central"

CONFIG_PRINTK=y
CONFIG_SHELL=y

# DEBUGGING
CONFIG_DEBUG=y
CONFIG_LOG=y
CONFIG_LOG_RUNTIME_FILTERING=y
CONFIG_BT_AUDIO_LOG_LEVEL_DBG=y
CONFIG_BT_VCP_VOL_CTLR_LOG_LEVEL_DBG=y
CONFIG_BT_AICS_LOG_LEVEL_DBG=y
CONFIG_BT_VOCS_LOG_LEVEL_DBG=y
CONFIG_BT_AICS_CLIENT_LOG_LEVEL_DBG=n
CONFIG_BT_VOCS_CLIENT_LOG_LEVEL_DBG=n
CONFIG_LV_USE_LOG=n
```

## src/main.c
```c
/*
 * Copyright (c) 2024 Demant A/S
 * SPDX-License-Identifier: Apache-2.0
 */

 #include <errno.h>
 #include <stdlib.h>
 #include <string.h>
 #include <lvgl.h>
 #include <zephyr/kernel.h>
 #include <zephyr/sys/printk.h>
 #include "display_manager.h"
 #include "lcd.h"
static lv_obj_t* scr;




int main(void){

    int err;
    scr = lv_scr_act();
    err = display_init();
    if (err) {
        printk("Device not ready!\n");
        return 0;
    }
    printk("Display initialized.\n");
    create_devices_page(scr);
    while (1) {
        lv_task_handler();
        k_sleep(K_MSEC(50));
    }
}
```

## src/display_manager.c
```c
#include <errno.h>
#include <stdlib.h>
#include <string.h>
#include <lvgl.h>
#include <zephyr/kernel.h>
#include <zephyr/sys/printk.h>
#include <zephyr/device.h>
#include <zephyr/drivers/display.h>

#include "lcd.h"
#include "display_manager.h"
int display_init(void)
{
    return lcd_init();

}
/*
Event to happen in the case of clicking in "Devices" Button
*/
void devices_btn_event(lv_event_t *e){
    printk("Devices click event");
}
/*
Event to happen in the case of clicking in "Broadcasts" Button
*/
void broadcasts_btn_event(lv_event_t *e){
    printk("Broadcasts click event");
}
void create_navigation_buttons(lv_obj_t* scr){
    lv_obj_t *devices_btn, *broadcasts_btn;
    devices_btn = lcd_create_button(scr, "Devices", 140, 50, -75, -80, devices_btn_event);
    broadcasts_btn = lcd_create_button(scr, "Broadcasts", 140, 50, 75, -80, broadcasts_btn_event);
}
void create_devices_page(lv_obj_t* scr)
{

    lcd_clear_screen(scr);
    create_navigation_buttons(scr);

}


void create_buttons(lv_obj_t* scr)
{
    create_buttons_before_connecting(scr);
}
```

## src/display_manager.h
```c
#ifndef __DISPLAY_MANAGER_H__
#define __DISPLAY_MANAGER_H__

int display_init(void);
void create_devices_page(lv_obj_t* scr);

#endif
```

## src/lcd.c
```c
#include <errno.h>
#include <stdlib.h>
#include <string.h>
#include <lvgl.h>
#include <zephyr/kernel.h>
#include <zephyr/sys/printk.h>
#include <zephyr/device.h>
#include <zephyr/drivers/display.h>

#include "lcd.h"




static lv_style_transition_dsc_t button_trans_dsc;
static bool msg_label_created;
/*
BUTTON
*/
static lv_style_t button_style;
static lv_style_t button_style_pressed;
static lv_style_prop_t button_props[] = { LV_STYLE_OUTLINE_WIDTH, LV_STYLE_OUTLINE_OPA, 0 };

static void lcd_button_style_init(void)
{
    //initialize style
    lv_style_init(&button_style);
    //Radius of the edges of the button
    lv_style_set_radius(&button_style, 5);
    //Opacity
    lv_style_set_bg_opa(&button_style, LV_OPA_100);
    //Color
    lv_style_set_bg_color(&button_style, lv_palette_main(LV_PALETTE_DEEP_PURPLE));
    //Gradient color
    lv_style_set_bg_grad_color(&button_style,
                               lv_palette_darken(LV_PALETTE_DEEP_PURPLE, 1));
    //Gradient Direction
    lv_style_set_bg_grad_dir(&button_style, LV_GRAD_DIR_VER);
    //Border Opacity
    lv_style_set_border_opa(&button_style, LV_OPA_100);
    //BorderWidth
    lv_style_set_border_width(&button_style, 2);
    //BorderColor
    lv_style_set_border_color(&button_style,
                              lv_palette_darken(LV_PALETTE_DEEP_PURPLE, 2));
    //outline opacity
    lv_style_set_outline_opa(&button_style, LV_OPA_COVER);
    //outline color
    lv_style_set_outline_color(&button_style, lv_palette_darken(LV_PALETTE_DEEP_PURPLE, 3));
    //text color
    lv_style_set_text_color(&button_style, lv_palette_main(LV_PALETTE_AMBER));
    //padding
    lv_style_set_pad_all(&button_style, 10);
    //set the pressed style
    lv_style_init(&button_style_pressed);

    lv_style_set_outline_width(&button_style_pressed, 10);
    lv_style_set_outline_opa(&button_style_pressed, LV_OPA_TRANSP);

    lv_style_set_bg_color(&button_style_pressed, lv_palette_darken(LV_PALETTE_DEEP_PURPLE, 2));
    lv_style_set_bg_grad_color(&button_style_pressed,
                               lv_palette_darken(LV_PALETTE_DEEP_PURPLE, 4));

    lv_style_transition_dsc_init(&button_trans_dsc, button_props, lv_anim_path_linear,
                                 100, 0, NULL);
    lv_style_set_transition(&button_style_pressed, &button_trans_dsc);
}


lv_obj_t *lcd_create_button(lv_obj_t *parent, const char *text, int32_t w, int32_t h,
    lv_coord_t x, lv_coord_t y, lv_event_cb_t cb)
{
    lv_obj_t *button = lv_btn_create(parent);
    lv_obj_remove_style_all(button);
    lv_obj_add_style(button, &button_style, LV_STATE_DEFAULT);
    lv_obj_add_style(button, &button_style_pressed, LV_STATE_PRESSED);
    lv_obj_set_size(button, w, h);
    lv_obj_align(button, LV_ALIGN_CENTER, x, y);

    lv_obj_add_event_cb(button, cb, LV_EVENT_CLICKED, NULL);

    lv_obj_t *label = lv_label_create(button);
    lv_label_set_text(label, text);
    lv_obj_center(label);

    return button;
}
/*
LABEL
*/
lv_obj_t *lcd_create_label(lv_obj_t *parent, const char *text, lv_coord_t x, lv_coord_t y)
{
    lv_obj_t *msg_label = lv_label_create(parent);
    lv_label_set_text(msg_label, text);
    lv_obj_align(msg_label, LV_ALIGN_CENTER, x, y);

msg_label_created = true;

return msg_label;
}
/*
UTIL
*/
void lcd_clear_screen(lv_obj_t *parent)
{
    k_sleep(K_MSEC(300));
    lv_obj_clean(parent);
    k_sleep(K_MSEC(300));}
void lcd_display_message(lv_obj_t *lbl, const char *msg)
{
    if(msg_label_created) {
        lv_label_set_text(lbl, msg);
    }
}

int lcd_init(void)
{
    lv_init();

    const struct device *display_dev = DEVICE_DT_GET(DT_CHOSEN(zephyr_display));

    if (!device_is_ready(display_dev)) {
        return -1;
    }

    display_blanking_off(display_dev);
    //lcd_slider_style_init();
    lcd_button_style_init();
    //lcd_voice_icon_style_init();
    //lcd_mute_icon_style_init();

    return 0;
}
```

## src/lcd.h
```c
#ifndef __LCD_H
#define __LCD_H

#define LCD_X_MAX   160
#define LCD_X_MIN   -160
#define LCD_Y_MAX   120
#define LCD_Y_MIN   -120

//initialize lcd component styles
int lcd_init(void);
void lcd_clear_screen(lv_obj_t *parent);
lv_obj_t *lcd_create_button(lv_obj_t *parent, const char *text, int32_t w, int32_t h,
    lv_coord_t x, lv_coord_t y, lv_event_cb_t cb);
lv_obj_t *lcd_create_label(lv_obj_t *parent, const char *text, lv_coord_t x, lv_coord_t y);

#endif /* __LCD_H */
```
